//在学习串口通信的时候一定要结合单片机的数据手册串口通信板块
//里面所包含的信息,不然会两眼发黑

/*
全双工：通信双方可以在同一时刻互相传输数据
半双工：通信双方可以互相传输数据，但必须分时复用一根数据线
单工：通信只能有一方发送到另一方，不能反向传输
异步：通信双方各自约定通信速率
同步：通信双方靠一根时钟线来约定通信速率
总线：连接各个设备的数据传输线路（类似于一条马路，把路边各住户连接起来，使住户可以相互交流）


定时器四模式:
模式0:普通计时标准模式
模式1:串口通信标准模式(我是渣渣辉,是串口就来选我!!!)
模式2:???????
模式3:???????
模式0和模式1在配置的时候略有不同
例如TH0 TL0用于配置计数器最高位和最低位,通常用于设置时间
而TH1 TL1如果用于串口通信,通常用于设置波特率


小芝士:波特率就相当于通信频率,只有通信频率在一个频道上
才能够准确的接听对方的消息,不然消息会有错误


//关键部件 
1.SCON  (串口控制寄存器)//控制串口模式
2.SBUF (串口缓冲寄存器)//发送和接收数据

//小芝士:当单片机从外部接收数据的时候,外部的数据会被存放到SBUF缓冲区
你需要做的就是设置一个变量,将SBUF中的数据取出来
例如: int temp = SBUF;
后面你需要执行一些操作的话直接调用temp这个变量就行



3.PCON (电源缓冲寄存器)//设置电源模式
*/


/*
SCON-串口控制寄存器

位   名称                 说明
SM0  串口模式选择位       与 SM1 配合选择工作模式
SM1  串口模式选择位       00=模式0，01=模式1，10=模式2，11=模式3
REN  接收允许位           需手动设置,1表示允许接收,0表示不能接收
TI   发送中断标志位       发送后返回1，需手动清零
RI   接收中断标志位       接收后返回1，需手动清零


//===================上面的才是有用的==============================

SM2  多机通信控制位       一般置 0；在多机通信时用于判断是否接收数据
TB8  发送数据的第 9 位    用于模式2/3，或多机通信(不用模式2,3不用管)
RB8  接收到的第 9 位      用于模式2/3，或多机通信(不用模式2,3不用管)
*/





#include <REGX52.H>
#include "Delay.h"
#include "Timer0.h"//操作的是定时器1,主要是我改不了名字


//初始化串口
void UART_Init()
{
    //1.配置串口模式
    SCON = 0x50;//0101 0000 即模式1---串口通信标准模式
    
    //2.初始化定时器
   Timer1_Init();
    
}



/*
interrupt中断函数
0 → 外部中断 0
1 → 定时器 0 中断
2 → 外部中断 1
3 → 定时器 1 中断
*/



unsigned char byte = 0;

//单片机串口接收函数(单片机接收)
void UART_ISR(void) interrupt 4//定时器1中断,
{
   
    if(RI)//单片机数据标志位  接收到后 = 1
    {
        RI = 0;//清空单片机接收数据标志位
        
        byte = SBUF;//
        
        switch(byte)
        {
             case '1' : P2_0 = 0;Delay(500);P2_0 = 1;break;
             case '2' : P2_1 = 0;Delay(500);P2_1 = 1;break;
             case '3' : P2_2 = 0;Delay(500);P2_2 = 1;break;
             case '4' : P2_3 = 0;Delay(500);P2_3 = 1;break;
             case '5' : P2_4 = 0;Delay(500);P2_4 = 1;break;
             case '6' : P2_5 = 0;Delay(500);P2_5 = 1;break;
             case '7' : P2_6 = 0;Delay(500);P2_6 = 1;break;
             case '8' : P2_7 = 0;Delay(500);P2_7 = 1;break;
             
        }
        
        
    }
    

}




//单片机串口发送函数(单片机发送)
void UART_SendByte(char byte)
{
    SBUF = byte;//SBUF是专用的缓冲区,将写入的数据线存放到这里面等待
    
    while(TI == 0);//当数据成功输出后TI会返回1,否则是0
    
    TI = 0; 
}








void main()
{
    
    UART_Init();
    
    //中断
    ES = 1;//开启串口中断
    EA = 1;//开启总中断
    
    
    while(1)
    {
        //UART_ISR(); <-------------------这个写法绝对不能够出现
        //单片机从外部接收函数不需要调用中断函数就能够自动中断
        //如果手动中断极易出现问题,所以单片机的接收中断函数千万不要手动调用
        //这鬼地方是问豆包才问出来的
       
        Delay(500);//接收后需要一段时间进行数据处理
        
        /*
        UART_SendByte()；
        Delay(500);
        */
    }
    
    
}